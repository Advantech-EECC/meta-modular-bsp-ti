## conf/layer.conf
```bitbake
BBPATH .= ":${LAYERDIR}"

BBFILES += "${LAYERDIR}/recipes-*/*/*.bb \
            ${LAYERDIR}/recipes-*/*/*.bbappend"

BBFILE_COLLECTIONS += "eecc-ti"
BBFILE_PATTERN_eecc-ti = "^${LAYERDIR}/"
BBFILE_PRIORITY_eecc-ti = "9"
LAYERDEPENDS_eecc-ti = "core"
LAYERVERSION_eecc-ti = "4"
LAYERSERIES_COMPAT_eecc-ti = "scarthgap"
```

## conf/machine/ecu1270-2g.conf
```bitbake
MACHINEOVERRIDES =. "ecu1270:"

# TI AM6734 is a J722S subset without GPU

require conf/machine/j722s-evm.conf

EVK_KERNEL_DEVICETREES := "${KERNEL_DEVICETREE_PREFIX}"
KERNEL_DEVICETREE_PREFIX:remove = "${EVK_KERNEL_DEVICETREES}"
KERNEL_DEVICETREE_PREFIX:append = " \
    ./ti/k3-j722s \
    ./ti/k3-fpdlink \
    ./ti/k3-v3link \
"

KERNEL_DEVICETREE:append = " ti/${MACHINE}.dtb"

IMAGE_BOOT_FILES:append = " \
    ${MACHINE}.dtb \
"

PREFERRED_PROVIDER_virtual/kernel = "${@'linux-ti-staging-rt' if d.getVar('ENABLE_RT') == '1' else 'linux-ti-staging'}"

IMAGE_INSTALL:append = " \
    i2c-tools \
    libgpiod \
    libgpiod-tools \
    optee-test \
    pciutils \
    usbutils \
"
```
